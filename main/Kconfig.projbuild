## main/Kconfig.projbuild
```kconfig
menu "SimpleGoX ESP Configuration"

    config SIMPLEGO_WIFI_SSID
        string "WiFi SSID"
        default ""
        help
            WiFi network name to connect to.

    config SIMPLEGO_WIFI_PASSWORD
        string "WiFi Password"
        default ""
        help
            WiFi network password.

    config SIMPLEGO_MATRIX_HOMESERVER
        string "Matrix Homeserver URL"
        default "https://matrix.simplego.dev"
        help
            Full URL of the Matrix homeserver including https://.

    config SIMPLEGO_MATRIX_USERNAME
        string "Matrix Username"
        default "iot-light"
        help
            Matrix username (localpart only, without @).

    config SIMPLEGO_MATRIX_PASSWORD
        string "Matrix Password"
        default ""
        help
            Matrix account password.

    config SIMPLEGO_MATRIX_ROOM
        string "Matrix Room"
        default "#iot:simplego.dev"
        help
            Matrix room alias or room ID to join and listen in.

    config SIMPLEGO_RELAY_GPIO
        int "Relay GPIO Pin"
        default 43
        help
            GPIO pin number connected to the relay module.
            Default 43 (Grove TX) avoids T-Deck Plus trackball conflict.
            GPIO 2 is used by the trackball on T-Deck Plus.

    config SIMPLEGO_IOT_DEVICE_ID
        string "IoT Device ID"
        default "light-kitchen"
        help
            Unique device identifier. Format: type-location (e.g.
            light-kitchen, temp-bedroom, doorbell-front).

    config SIMPLEGO_IOT_DEVICE_TYPE
        string "IoT Device Type"
        default "switch"
        help
            Device type: switch, sensor, button, dimmer.

    config SIMPLEGO_IOT_DEVICE_LABEL
        string "IoT Device Label"
        default "Kitchen Light"
        help
            Human-readable name shown in the SimpleGoX UI.

    config SIMPLEGO_IOT_DEVICE_ICON
        string "IoT Device Icon"
        default "lightbulb"
        help
            Icon name: lightbulb, thermometer, humidity, doorbell,
            dimmer, fan, lock, camera, device.

endmenu
```

## sdkconfig.defaults
```kconfig
# SimpleGoX ESP - sdkconfig defaults for ESP32-S3

# Target
CONFIG_IDF_TARGET="esp32s3"

# WiFi
CONFIG_ESP_WIFI_ENABLED=y

# TLS / HTTPS
CONFIG_ESP_TLS_USING_MBEDTLS=y
CONFIG_MBEDTLS_CERTIFICATE_BUNDLE=y
CONFIG_MBEDTLS_CERTIFICATE_BUNDLE_DEFAULT_FULL=y

# HTTP client
CONFIG_ESP_HTTP_CLIENT_ENABLE_HTTPS=y

# mbedTLS crypto (HW-accelerated on ESP32-S3)
CONFIG_MBEDTLS_HARDWARE_AES=y
CONFIG_MBEDTLS_HARDWARE_SHA=y
CONFIG_MBEDTLS_HARDWARE_MPI=y
CONFIG_MBEDTLS_HKDF_C=y

# NVS
CONFIG_NVS_ENCRYPTION=n

# FreeRTOS
CONFIG_FREERTOS_HZ=1000

# Main task stack size (16 KB)
CONFIG_ESP_MAIN_TASK_STACK_SIZE=16384

# System
CONFIG_ESP_SYSTEM_EVENT_TASK_STACK_SIZE=4096

# Partition table
CONFIG_PARTITION_TABLE_CUSTOM=y
CONFIG_PARTITION_TABLE_CUSTOM_FILENAME="partitions.csv"

# Heap debugging
CONFIG_HEAP_POISONING_COMPREHENSIVE=y

# Log level
CONFIG_LOG_DEFAULT_LEVEL_INFO=y
CONFIG_LOG_DEFAULT_LEVEL=3
```
